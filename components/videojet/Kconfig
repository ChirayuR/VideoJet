## components/videojet/Kconfig
```kconfig
menu "VideoJet"

config VJ_PROFILE
    bool "Per-stage cycle counters (profiling builds only)"
    default n
    help
        Brackets the decoder's parse / reconstruct / inter / deblock stages with CCOUNT reads, readable through
        vj_profile_take(). Its cost is not separable from code-layout noise (docs/bench-log.md) and it moves code layout:
        never use it for timed scores.

config VJ_ERROR_PRINT
    bool "Print h264bsd bitstream errors to stderr"
    default n
    help
        Compiles in the vendored decoder's ~60 error prints. They print from the decoding task.

config VJ_IRAM
    bool "Run the decoder from internal RAM (code and tables)"
    default y
    help
        Puts libvideojet's hot code (49,071 B, IRAM) and its tables (7,695 B, DRAM) in internal RAM;
        concealment, parameter-set parsing and NAL extraction (once per error, SPS/PPS or NAL) stay in flash. On the
        bench the code gained +1 / +11 / +21 % fps (aux_card / aux_map / full_map) over flash code with the
        default 16 KB I-cache, and moving it changed fps by at most 0.11 %; the tables in DRAM gained another
        +0.7 / +1.4 / +2.0 % on top. Off: code and tables stay in flash; with a 32 KB I-cache that was within
        1 % of code-in-IRAM at step 0, so expect about 1 / 2 / 3 % below this default (estimate).

config VJ_DCACHE_AUTOLOAD
    bool "D-cache autoload over the decoder's PSRAM working set"
    depends on IDF_TARGET_ESP32S3 && SPIRAM
    default n
    help
        Turns on the data cache's hardware autoload (a prefetch: after a miss it also fetches the next cache
        lines) over the span of the decoder's own PSRAM blocks (the frames and the per-macroblock state: about
        1.5 MB at 800x480), at the start of every vj_decode_au(), from the second decode call on. It only
        decides which lines are already cached, so the decoder's own output cannot change.
        Scored (T11, record m3-autoload, 800x480, slow PSRAM class, 64 KB D-cache with 64 B lines, size 1):
        73.87 / 17.84 / 8.82 -> 80.77 / 18.74 / 9.22 fps, +9.35 / +5.05 / +4.54 % (aux_card / aux_map /
        full_map).

        It is a global cache setting made with the ROM cache calls Cache_Config_DCache_Autoload,
        Cache_Config_DCache_Region_Autoload and Cache_Enable_DCache_Autoload, which IDF marks as not for
        applications. The library takes over autoload region 0 and its trigger, order and size (nothing else in
        IDF 5.4 configures D-cache autoload). There is one region: with several decoders the last caller wins.
        Autoload stays on when a call returns and after vj_decoder_destroy(), with the region and the enable
        still on the freed blocks. The boot default is off and you opted in by enabling this.
        Cache_Disable_DCache_Autoload() stops it only after the last vj_decode_au(): every call enables it again.

        IDF suspends autoload around its cache write-back (esp_cache_msync C2M) because of an S3 erratum, and
        esp_lcd's RGB panel starts manual preloads that suspend it. vj_decode_au() on another core re-enables it
        without coordination. If you write back PSRAM or use an RGB panel with a PSRAM framebuffer, keep those
        on the decoder's task or leave this option off (unmeasured).

        The span can include your own PSRAM that lies between the decoder's blocks: autoload only reads, but a
        buffer that DMA writes there needs esp_cache_msync(M2C) before the CPU reads it, as IDF already
        requires. Two traps are handled: a region that ends at 0x3E000000 (the end of the data window) panics
        in Cache_Enable_DCache_Autoload() (the end is clamped below it), and any IDF flash operation
        (esp_partition_read, NVS, OTA) clears the enable bit (every vj_decode_au() sets it again). The call that
        first activates an SPS allocates the decoder's blocks, so that picture decodes before the region exists.
        Evidence for these rules: docs/bench-log.md, "D-cache autoload (T11)".

config VJ_DCACHE_AUTOLOAD_SIZE
    int "Lines fetched after a miss, minus one (0 to 3)"
    depends on VJ_DCACHE_AUTOLOAD
    range 0 3
    default 1
    help
        A miss requests this + 1 cache lines after the missed one (64 B each with the recommended 64 B
        D-cache line; the numbers here are for that line). Only size 1 was scored on this code (see above). In
        the earlier autoload experiment (region = the whole PSRAM mapping, armed before the first picture) size 1
        gave +9.50 / +5.08 / +4.41 %, size 3 +0.34 / +5.47 / +6.40 % (it favoured full_map) and size 0
        -3.39 / -0.25 / +0.31 %.

config VJ_PIE
    bool "Motion compensation and inverse transform in PIE SIMD assembly (ESP32-S3)"
    depends on IDF_TARGET_ESP32S3
    default y
    help
        Luma and chroma interpolation of partitions 8 or 16 wide whose reference window lies inside the picture run
        as ESP32-S3 PIE (128-bit SIMD) kernels; the rest, and every host build, use the C kernels, which the PIE ones
        match bit for bit. Each destination must be aligned to its store width (16 B luma w 16, 8 B w 8, 4 B chroma
        w 4); the library checks per partition and otherwise uses C.
        The inter write-out (residual add, clip, store) also runs as PIE when the residual array is 16-aligned.

        The 4x4 inverse transform of a block with coefficients outside its first row (h264bsdProcessBlock) runs in PIE too,
        when the block is 16-byte aligned and every dequantised coefficient is within +-2^26; otherwise C, bit for bit the same.

        IDF pins a task to its current core at its first PIE instruction (portasm.S _frxt_coproc_exc_hook), so an unpinned decode task (any task that calls vj_decode_au) is pinned permanently, normally at its first I-frame (the first block with AC coefficients).

config VJ_DEBLOCK_WORKER
    bool "Deblock on a worker task on the other core"
    default n
    help
        The in-loop deblocking filter (a fifth to a quarter of a frame on the maps) runs on a worker task while the
        decoding task decodes the next macroblock rows: it filters row r once row r + 1 is decoded, in raster order,
        with the records made at decode time; the decoding task finishes the picture by waiting for the last rows.
        The output is bit-identical to the sequential decoder on every path, damaged streams included. Pictures with
        slice groups (FMO) or redundant slices, and the rows of I slices, are filtered at the end of the picture
        without overlap. After a slice error, the rows the worker filtered under the failed slice are put back from
        an undo log (a few rows at most; none for a picture of one slice) before the picture goes on as the
        sequential decoder's; the argument is in h264bsd_deblocking.c.

        vj_decoder_create() creates the worker (the task calling it is "the decoding task"): pinned to
        VJ_WORKER_CORE, at the creating task's priority, with a 2 KB internal stack (about 1 KB used);
        vj_decoder_destroy() deletes it. vj_decode_au() returns with the worker idle. Costs per decoder at
        800x480: about 2.7 KB of internal RAM (2 KB stack, control blocks) and 118 KB of PSRAM (the undo log, 4 rows of
        576 B per macroblock, which scales with the picture width, and 1.5 KB of marks). Code: 2.6 KB of IRAM.
        The VJP_DEBLOCK profile bucket (VJ_PROFILE) measures only the decoding task's wait for the worker when this is on.

        Rules for the consumer: call vj_decoder_create(), vj_decode_au() and vj_decoder_destroy() from one task,
        pinned to one core, and never delete that task while a decode is in flight (the worker would go on filtering
        buffers that are then freed). Starvation: if a task on the worker's core at or above the worker's priority keeps
        it from starting, vj_decode_au() takes the posted run back after 50 ms and filters on the decoding task (still
        bit-identical, just no overlap); a run the worker has started is waited for however long it takes, so a task that
        preempts the worker in the middle of a run can still stall the call for as long as it runs. An unpinned
        decoding task scheduled onto the worker's core is correct, but the two then take turns. D-cache and PSRAM
        bandwidth are shared between the cores: the decoding task slows a little while the worker runs.

config VJ_WORKER_CORE
    int "Core of the deblock worker (-1: the core other than the one that creates the decoder)"
    depends on VJ_DEBLOCK_WORKER
    range -1 1
    default -1
    help
        -1 puts the worker on the other core than the task calling vj_decoder_create() (core 0 on a single-core
        build). 0 or 1 pins it there; 1 on a single-core build (FREERTOS_UNICORE) is clamped to 0.

config VJ_WORKER_PRIORITY
    int "Priority of the deblock worker (0: the priority of the task that creates the decoder)"
    depends on VJ_DEBLOCK_WORKER
    range 0 24
    default 0
    help
        0 runs the worker at the creating task's priority (the bench). A consumer with other work on the worker's
        core places it there: below a task that must never wait for it (a network reader), above work that can trail
        the decode (a display conversion). A task above the worker that delays the start of a run makes the decoding
        task take the run back after 50 ms; one that preempts a started run stalls the decode while it runs.

config VJ_PARSE_PIPELINE
    bool "Parse macroblocks on the other core, ahead of the decoding task"
    depends on VJ_DEBLOCK_WORKER && !FREERTOS_UNICORE
    default n
    help
        The deblock worker's task (core VJ_WORKER_CORE) also runs the bitstream parser: it parses the slice's macroblocks
        (skip runs, macroblock_layer, CAVLC) into a ring of 6 records while the decoding task reconstructs the earlier ones,
        and filters in segments of 10 macroblocks between records. The parser reads nothing the decoding task writes, so
        the output (pixels, status, concealment, errors) is bit-identical to the sequential decoder on every path,
        damaged streams included: a parse error becomes a record the decoding task reaches in order.
        Slices with slice groups (FMO) or redundant slices, and single-core builds (or a worker on the decoding task's
        own core), parse on the decoding task as before. If the worker task produces no record for 50 ms, the decoding
        task takes the parser back and parses itself.
        The worker task stays runnable through each slice it parses: it parses while the ring has room, filters in
        between, and polls for about 200 us when the ring is full and the decoding task has freed no slot; after that it
        sleeps until the decoding task frees one (the decoding task wakes it only if it is asleep, so there is no
        kernel call per macroblock in the normal case). Tasks on the worker's core with a lower priority than the worker
        (the priority of the task that created the decoder) run only in its gaps between slices and while it sleeps. Work
        that must run on that core during a decode needs a higher priority than the worker; it then preempts the worker
        and stalls the decode for as long as it runs (after 50 ms without a record the decoding task takes the parser
        back). One decoder per worker core.
        Internal RAM at 800x480, measured on the bench: 95,445 B with the pipeline (static 58,493 + heap 36,952) against
        99,166 B without it (56,774 + 42,392): the pipeline needs a ring of 6 records (2,112 B each, less the one the
        decoder always had), a neighbour shadow (1.3 KB) and a 3 KB worker stack (1,132 B used), and in return the 18,000 B
        of deblock records live in PSRAM (which costs the decoding task about 4 % on a static picture). The worker's task
        needs the esp_timer clock for the 50 ms take-back (a core-independent clock: the decoding task may not be pinned).
        Unpinned decoding tasks are safe: a task that lands on the worker's core waits by sleeping a tick, never by
        spinning the worker out of the CPU, and a slice that starts on the worker's own core is parsed inline. After a
        take-back the next 30 slices are parsed inline before the worker is asked again.

endmenu
```
